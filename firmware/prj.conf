## CMakeLists.txt
```
cmake_minimum_required(VERSION 3.20.0)

find_package(Zephyr REQUIRED HINTS $ENV{ZEPHYR_BASE})
project(fido2_node_bench)

target_sources(app PRIVATE
  src/main.c
  src/stats.c
)
target_include_directories(app PRIVATE src)

if(CONFIG_USB_DEVICE_STACK_NEXT)
  target_sources(app PRIVATE src/usb.c)
endif()

if(CONFIG_FIDO2)
  target_sources(app PRIVATE src/up_timing.c)
endif()
```

## Kconfig
```
mainmenu "FIDO2 coexistence experiment"

source "Kconfig.zephyr"

menu "Experiment"

config BENCH_BUILD_ID
	string "Build identity"
	default "unrecorded"

config BENCH_NODE_ID
	string "Commissioned node identifier (ASCII letters, digits, underscore or hyphen)"
	default "node-001"

config BENCH_VARIANT
	string "Build configuration label"
	default "baseline"

config BENCH_CONTROL_CDC_ACM
	bool "Use USB CDC ACM for the experiment control channel"
	depends on USB_DEVICE_STACK_NEXT && USBD_CDC_ACM_CLASS
	help
	  Enable CDC control in all firmware variants.
	  The host asserts DTR. HID and CDC share the native USB connection.

config BENCH_USB_VID
	hex "USB vendor ID"
	default 0

config BENCH_USB_PID
	hex "USB product ID"
	default 0

config BENCH_PERIOD_MS
	int "Periodic task interval in milliseconds"
	default 100
	range 1 10000

config BENCH_DEADLINE_MS
	int "Relative deadline in milliseconds"
	default 100
	range 1 10000

config BENCH_WORK_ROUNDS
	int "Deterministic integer processing rounds per release"
	default 1000
	range 0 10000000

config BENCH_WORK_PRIORITY
	int "Workload preemptive thread priority"
	default 5
	range 0 14

config BENCH_SENSOR
	bool "Use the ambient-temperature sensor at alias bench-sensor"
	select SENSOR
	help
	  Use a deterministic synthetic trace when disabled.

endmenu
```

## prj.conf
```kconfig
CONFIG_SERIAL=y
CONFIG_UART_INTERRUPT_DRIVEN=y
CONFIG_CONSOLE=n
CONFIG_UART_CONSOLE=n
CONFIG_LOG=n
CONFIG_GPIO=y
CONFIG_MAIN_STACK_SIZE=4096
CONFIG_SYSTEM_WORKQUEUE_STACK_SIZE=2048
CONFIG_SYS_CLOCK_TICKS_PER_SEC=10000
CONFIG_SMP=n
CONFIG_BENCH_PERIOD_MS=100
CONFIG_BENCH_DEADLINE_MS=100
CONFIG_BENCH_WORK_PRIORITY=5
```

## src/main.c
```c
#include <ctype.h>
#include <errno.h>
#include <stdarg.h>
#include <stdio.h>
#include <stdlib.h>
#include <string.h>

#include <zephyr/device.h>
#include <zephyr/drivers/gpio.h>
#include <zephyr/drivers/uart.h>
#include <zephyr/kernel.h>
#include <zephyr/logging/log.h>
#include <zephyr/sys/atomic.h>

#if defined(CONFIG_FIDO2)
#include <zephyr/authentication/fido2/fido2.h>
#endif

#if defined(CONFIG_BENCH_SENSOR)
#include <zephyr/drivers/sensor.h>
#endif

#include "bench.h"
#include "bench_clock.h"
#include "stats.h"

LOG_MODULE_REGISTER(bench, LOG_LEVEL_INF);

#if defined(CONFIG_BENCH_SENSOR)
static const struct device *const sensor = DEVICE_DT_GET(DT_ALIAS(bench_sensor));
#endif

#if DT_NODE_HAS_STATUS(DT_ALIAS(led0), okay) && DT_NODE_HAS_PROP(DT_ALIAS(led0), gpios)
#define HAVE_ALARM_LED 1
static const struct gpio_dt_spec led = GPIO_DT_SPEC_GET(DT_ALIAS(led0), gpios);
static bool led_ready;
#endif

BUILD_ASSERT(CONFIG_BENCH_DEADLINE_MS <= CONFIG_BENCH_PERIOD_MS,
	     "This experiment assumes a deadline no longer than the period");

static const struct device *const control_uart = DEVICE_DT_GET(DT_CHOSEN(bench_control_uart));

K_MSGQ_DEFINE(rx_bytes, 1, 512, 1);
K_SEM_DEFINE(run_start, 0, 1);
K_SEM_DEFINE(run_done, 1, 1);
K_SEM_DEFINE(tx_done, 0, 1);

static atomic_t running;
static atomic_t rx_overflows;
static atomic_t tx_timeouts;
static atomic_t threshold = ATOMIC_INIT(30000);
static atomic_t sample_value;
static atomic_t filtered_value;
static atomic_t alarm_value;
static atomic_t generation;
/* Prevent optimization of the synthetic workload. */
static volatile uint32_t work_sink;
static uint32_t work_rounds = CONFIG_BENCH_WORK_ROUNDS;
static struct bench_stats stats;
static uint64_t run_begin;
static uint64_t run_end;
static uint64_t run_finished;
static uint64_t run_duration_ticks;
static uint32_t run_id;
static bool run_complete;
static int fido_error;
static int usb_error;
static int sensor_ready_error;
static char last_request[65];
static char reply[4096];
static size_t reply_len;
static bool reply_overflow;
static uint8_t tx_frame[4128];
static size_t tx_offset;
static size_t tx_length;
#if defined(CONFIG_BENCH_CONTROL_CDC_ACM)
K_MUTEX_DEFINE(tx_mutex);
#else
static struct k_spinlock tx_spinlock;
#endif
static k_tid_t workload_tid;

static k_spinlock_key_t tx_lock(void)
{
#if defined(CONFIG_BENCH_CONTROL_CDC_ACM)
	/* The CDC callback runs on a workqueue and may wait for the UDC mutex. */
	k_mutex_lock(&tx_mutex, K_FOREVER);
	return (k_spinlock_key_t){0};
#else
	return k_spin_lock(&tx_spinlock);
#endif
}

static void tx_unlock(k_spinlock_key_t key)
{
#if defined(CONFIG_BENCH_CONTROL_CDC_ACM)
	ARG_UNUSED(key);
	k_mutex_unlock(&tx_mutex);
#else
	k_spin_unlock(&tx_spinlock, key);
#endif
}

static bool safe_identifier(const char *s)
{
	if (!*s || strlen(s) > 63) {
		return false;
	}
	for (; *s; s++) {
		if (!isalnum((unsigned char)*s) && *s != '-' && *s != '_') {
			return false;
		}
	}
	return true;
}

static void reply_append(const char *fmt, ...)
{
	va_list args;
	int len;

	if (reply_overflow) {
		return;
	}

	va_start(args, fmt);
	len = vsnprintf(reply + reply_len, sizeof(reply) - reply_len, fmt, args);
	va_end(args);

	if (len < 0 || (size_t)len >= sizeof(reply) - reply_len) {
		reply_overflow = true;
	} else {
		reply_len += (size_t)len;
	}
}

static void send_reply(unsigned int id)
{
	const char *text =
		reply_overflow ? "{\"ok\":false,\"error\":\"response_overflow\"}" : reply;
	k_spinlock_key_t key = tx_lock();
	int n = snprintf((char *)tx_frame, sizeof(tx_frame), "\n@%u %s\n", id, text);

	if (n < 0 || (size_t)n >= sizeof(tx_frame)) {
		tx_unlock(key);
		return;
	}
	k_sem_reset(&tx_done);
	tx_offset = 0;
	tx_length = (size_t)n;
	uart_irq_tx_enable(control_uart);
	tx_unlock(key);

	/* The UART callback continues partial FIFO writes. */
	if (k_sem_take(&tx_done, K_SECONDS(3))) {
		key = tx_lock();
		uart_irq_tx_disable(control_uart);
		tx_length = 0;
		tx_unlock(key);
		atomic_inc(&tx_timeouts);
	}
}

static void uart_irq(const struct device *dev, void *unused)
{
	uint8_t data[16];

	ARG_UNUSED(unused);

	uart_irq_update(dev);

	while (uart_irq_rx_ready(dev)) {
		int n = uart_fifo_read(dev, data, sizeof(data));

		if (n <= 0) {
			break;
		}
		for (int i = 0; i < n; i++) {
			if (k_msgq_put(&rx_bytes, &data[i], K_NO_WAIT)) {
				atomic_inc(&rx_overflows);
			}
		}
	}
	if (uart_irq_tx_ready(dev)) {
		bool done = false;
		k_spinlock_key_t key = tx_lock();

		if (tx_offset < tx_length) {
			int accepted =
				uart_fifo_fill(dev, tx_frame + tx_offset, tx_length - tx_offset);

			if (accepted > 0) {
				tx_offset += (size_t)accepted;
			}
		}
		if (tx_offset >= tx_length) {
			uart_irq_tx_disable(dev);
			done = tx_length != 0;
			tx_length = 0;
		}
		if (done) {
			k_sem_give(&tx_done);
		}
		tx_unlock(key);
	}
}

static int read_sample(uint64_t index, int32_t *value)
{
#if defined(CONFIG_BENCH_SENSOR)
	struct sensor_value temp;
	int ret = sensor_sample_fetch(sensor);

	ARG_UNUSED(index);

	if (!ret) {
		ret = sensor_channel_get(sensor, SENSOR_CHAN_AMBIENT_TEMP, &temp);
	}
	if (ret) {
		return ret;
	}
	*value = temp.val1 * 1000 + temp.val2 / 1000;
#else
	/* Triangular temperature trace: 20..40 degrees C. */
	uint32_t phase = index % 400;

	*value = 20000 + (phase <= 200 ? phase : 400 - phase) * 100;
#endif
	return 0;
}

static void workload(void *a, void *b, void *c)
{
	const uint64_t period = k_ms_to_ticks_ceil64(CONFIG_BENCH_PERIOD_MS);
	const uint64_t deadline =
		bench_clock_from_ticks(k_ms_to_ticks_ceil64(CONFIG_BENCH_DEADLINE_MS));

	ARG_UNUSED(a);
	ARG_UNUSED(b);
	ARG_UNUSED(c);

	for (;;) {
		uint64_t due;
		int32_t filtered = 25000;
		uint32_t mixed = 0x9e3779b9U;
		uint64_t index = 0;

		k_sem_take(&run_start, K_FOREVER);
		due = run_begin;

		while (atomic_get(&running) && due < run_end) {
			uint64_t start;
			uint64_t finish;
			int32_t value = filtered;
			bool alarm;
			int ret;

			k_sleep(K_TIMEOUT_ABS_TICKS(due));
			if (!atomic_get(&running)) {
				break;
			}

			start = bench_clock_now();
			ret = read_sample(index, &value);
			if (ret) {
				stats.sensor_errors++;
			} else {
				filtered = (7 * filtered + value) / 8;
			}
			for (unsigned int i = 0; i < work_rounds; i++) {
				mixed ^= mixed << 13;
				mixed ^= mixed >> 17;
				mixed ^= mixed << 5;
			}
			work_sink = mixed;
			atomic_set(&sample_value, value);
			atomic_set(&filtered_value, filtered);
			alarm = filtered >= atomic_get(&threshold);
			atomic_set(&alarm_value, alarm);
#ifdef HAVE_ALARM_LED
			if (led_ready) {
				gpio_pin_set_dt(&led, alarm);
			}
#endif
			finish = bench_clock_now();
			bench_stats_add(&stats, bench_clock_from_ticks(due), start, finish,
					deadline, bench_hist_bin_units());
			due += period;
			index++;
			if (due < run_end) {
				uint64_t skipped = bench_skip_count(due, k_uptime_ticks(), period);
				uint64_t remaining = (run_end - due + period - 1) / period;

				if (skipped > remaining) {
					skipped = remaining;
				}
				stats.skipped_releases += skipped;
				due += skipped * period;
				index += skipped;
			}
		}
		if (atomic_get(&running) && due >= run_end) {
			k_sleep(K_TIMEOUT_ABS_TICKS(run_end));
		}
		run_complete = due >= run_end && k_uptime_ticks() >= run_end;
		run_finished = k_uptime_ticks();
		atomic_clear(&running);
		k_sem_give(&run_done);
	}
}

K_THREAD_DEFINE(workload_thread, 3072, workload, NULL, NULL, NULL, CONFIG_BENCH_WORK_PRIORITY, 0,
		0);

static void reply_hello(void)
{
	reply_append("{\"build_id\":\"%s\",", CONFIG_BENCH_BUILD_ID);
#if defined(CONFIG_FIDO2)
	reply_append("\"fido_priority\":%d,", CONFIG_FIDO2_THREAD_PRIORITY);
#else
	reply_append("\"fido_priority\":null,");
#endif
	reply_append("\"ok\":true,\"schema\":1,\"node_id\":\"%s\",\"variant\":\"%s\",",
		     CONFIG_BENCH_NODE_ID, CONFIG_BENCH_VARIANT);
	reply_append("\"fido_enabled\":%s,\"fido_error\":%d,\"usb_error\":%d,\"sensor_error\":%d,",
		     IS_ENABLED(CONFIG_FIDO2) ? "true" : "false", fido_error, usb_error,
		     sensor_ready_error);
	reply_append("\"workload\":\"%s\",\"period_ticks\":%llu,\"deadline_ticks\":%llu,",
		     IS_ENABLED(CONFIG_BENCH_SENSOR) ? "ambient_temperature_sensor"
						     : "synthetic_triangle",
		     (unsigned long long)k_ms_to_ticks_ceil64(CONFIG_BENCH_PERIOD_MS),
		     (unsigned long long)k_ms_to_ticks_ceil64(CONFIG_BENCH_DEADLINE_MS));
	reply_append("\"tick_hz\":%u,\"work_rounds\":%u,\"work_priority\":%d,",
		     CONFIG_SYS_CLOCK_TICKS_PER_SEC, work_rounds, CONFIG_BENCH_WORK_PRIORITY);
	reply_append("\"measurement_schema\":3,\"workload_clock\":\"%s\",\"clock_hz\":%u,",
		     IS_ENABLED(CONFIG_TIMER_HAS_64BIT_CYCLE_COUNTER) ? "cycle64" : "kernel_ticks",
		     bench_clock_hz());
	reply_append(
		"\"psa_provider\":\"%s\",\"up_clock\":\"%s\",",
		IS_ENABLED(CONFIG_BUILD_WITH_TFM)
			? "tfm"
			: (IS_ENABLED(CONFIG_SECURE_STORAGE) ? "zephyr_secure_storage" : "none"),
		IS_ENABLED(CONFIG_TIMER_HAS_64BIT_CYCLE_COUNTER) ? "cycle64" : "kernel_ticks");
	reply_append("\"control_transport\":\"%s\",\"spiram_enabled\":%s,\"touch_enabled\":%s}",
		     IS_ENABLED(CONFIG_BENCH_CONTROL_CDC_ACM) ? "usb_cdc_acm" : "physical_uart",
		     IS_ENABLED(CONFIG_ESP_SPIRAM) ? "true" : "false",
		     IS_ENABLED(CONFIG_INPUT_ESP32_TOUCH_SENSOR) ? "true" : "false");
}

static void reply_run_state(void)
{
	uint64_t now = k_uptime_ticks();
	bool active = atomic_get(&running) && now >= run_begin && now < run_end;

	reply_append(",\"run_id\":%u,\"now_tick\":%llu,\"begin_tick\":%llu,\"end_tick\":%llu,",
		     run_id, (unsigned long long)now, (unsigned long long)run_begin,
		     (unsigned long long)run_end);
	reply_append("\"window_active\":%s", active ? "true" : "false");
}

static void reply_status(void)
{
	reply_append("{\"ok\":true,\"running\":%s,\"threshold_mdegc\":%d,\"generation\":%u,",
		     atomic_get(&running) ? "true" : "false", (int)atomic_get(&threshold),
		     (unsigned int)atomic_get(&generation));
	reply_append("\"sample_mdegc\":%d,\"filtered_mdegc\":%d,\"alarm\":%s,",
		     (int)atomic_get(&sample_value), (int)atomic_get(&filtered_value),
		     atomic_get(&alarm_value) ? "true" : "false");
	reply_append("\"rx_overflows\":%u,\"tx_timeouts\":%u",
		     (unsigned int)atomic_get(&rx_overflows),
		     (unsigned int)atomic_get(&tx_timeouts));
	reply_run_state();
	reply_append("}");
}

static void reply_presence(void)
{
	struct bench_up_snapshot up = {0};

#if defined(CONFIG_FIDO2)
	bench_up_get(&up);
#endif
	reply_append("{\"ok\":true,\"sequence\":%llu,\"duration_ns\":%llu,\"result\":%d",
		     (unsigned long long)up.sequence, (unsigned long long)up.duration_ns,
		     up.result);
	reply_append(",\"pre_event_ns\":%llu,\"resume_delay_ns\":%llu,\"event_valid\":%s",
		     (unsigned long long)up.pre_event_ns, (unsigned long long)up.resume_delay_ns,
		     up.event_valid ? "true" : "false");
	reply_run_state();
	reply_append("}");
}

static void start_run(const char *duration_text)
{
	char *end;
	unsigned long duration = strtoul(duration_text, &end, 10);

	if (!*duration_text || *end || duration < 100 || duration > 3600000 || sensor_ready_error) {
		reply_append("{\"ok\":false,\"error\":\"invalid_duration_or_sensor\"}");
	} else if (!bench_clock_valid()) {
		reply_append("{\"ok\":false,\"error\":\"unsupported_clock_epoch_or_rate\"}");
	} else if (k_sem_take(&run_done, K_NO_WAIT)) {
		reply_append("{\"ok\":false,\"error\":\"already_running\"}");
	} else {
		memset(&stats, 0, sizeof(stats));
		run_begin = k_uptime_ticks() + k_ms_to_ticks_ceil64(CONFIG_BENCH_PERIOD_MS);
		run_duration_ticks = k_ms_to_ticks_ceil64(duration);
		run_end = run_begin + run_duration_ticks;
		run_finished = 0;
		run_complete = false;
		run_id++;
		atomic_set(&running, 1);
		k_sem_give(&run_start);
		reply_append("{\"ok\":true");
		reply_run_state();
		reply_append("}");
	}
}

static void stop_run(void)
{
	int ret;

	atomic_clear(&running);
	k_wakeup(workload_tid);
	ret = k_sem_take(&run_done, K_SECONDS(5));
	if (!ret) {
		k_sem_give(&run_done);
	}
	reply_append("{\"ok\":%s}", ret ? "false" : "true");
}

static void reply_stats(void)
{
	if (k_sem_take(&run_done, K_NO_WAIT)) {
		reply_append("{\"ok\":false,\"error\":\"stop_before_dump\"}");
		return;
	}

	reply_append("{\"ok\":true,\"complete\":%s,\"samples\":%llu,\"deadline_misses\":%llu,",
		     run_complete ? "true" : "false", (unsigned long long)stats.samples,
		     (unsigned long long)stats.deadline_misses);
	reply_append("\"skipped_releases\":%llu,\"sensor_errors\":%llu,",
		     (unsigned long long)stats.skipped_releases,
		     (unsigned long long)stats.sensor_errors);
	reply_append("\"measurement_schema\":3,\"clock_hz\":%u,\"histogram_bin_units\":%llu,",
		     bench_clock_hz(), (unsigned long long)bench_hist_bin_units());
	reply_append("\"max_lateness_units\":%llu,\"max_response_units\":%llu,",
		     (unsigned long long)stats.max_lateness_units,
		     (unsigned long long)stats.max_response_units);
	reply_append("\"max_execution_units\":%llu,\"sum_lateness_units\":%llu,",
		     (unsigned long long)stats.max_execution_units,
		     (unsigned long long)stats.sum_lateness_units);
	reply_append(
		"\"sum_execution_units\":%llu,\"captured_samples\":%u,\"dropped_samples\":%llu,",
		(unsigned long long)stats.sum_execution_units, stats.captured_samples,
		(unsigned long long)(stats.samples - stats.captured_samples));
	reply_append("\"run_id\":%u,\"begin_tick\":%llu,", run_id, (unsigned long long)run_begin);
	reply_append("\"end_tick\":%llu,\"finished_tick\":%llu,\"histogram\":[",
		     (unsigned long long)run_end, (unsigned long long)run_finished);

	for (unsigned int i = 0; i < BENCH_HIST_BINS; i++) {
		reply_append("%s%u", i ? "," : "", stats.histogram[i]);
	}

	reply_append("]}");
	k_sem_give(&run_done);
}

static void configure_work(const char *text)
{
	char *end;
	unsigned long value = strtoul(text, &end, 10);

	if (!*text || *end || value > 10000000) {
		reply_append("{\"ok\":false,\"error\":\"invalid_rounds\"}");
	} else if (k_sem_take(&run_done, K_NO_WAIT)) {
		reply_append("{\"ok\":false,\"error\":\"stop_before_configure\"}");
	} else {
		work_rounds = value;
		k_sem_give(&run_done);
		reply_append("{\"ok\":true,\"work_rounds\":%u}", work_rounds);
	}
}

static void reply_samples(const char *text)
{
	char *end;
	unsigned long offset = strtoul(text, &end, 10);

	if (!*text || *end || offset > BENCH_SAMPLE_CAPACITY) {
		reply_append("{\"ok\":false,\"error\":\"invalid_offset\"}");
		return;
	}
	if (k_sem_take(&run_done, K_NO_WAIT)) {
		reply_append("{\"ok\":false,\"error\":\"stop_before_dump\"}");
		return;
	}

	reply_append("{\"ok\":true,\"run_id\":%u,\"offset\":%lu,\"samples\":[", run_id, offset);
	for (unsigned int i = offset; i < stats.captured_samples && i < offset + 32; i++) {
		const struct bench_sample *sample = &stats.captured[i];

		reply_append("%s[%llu,%llu,%llu]", i > offset ? "," : "",
			     (unsigned long long)sample->lateness_units,
			     (unsigned long long)sample->response_units,
			     (unsigned long long)sample->execution_units);
	}
	reply_append("]}");
	k_sem_give(&run_done);
}

static void apply_threshold(const char *nonce, const char *threshold_text)
{
	char *end;
	bool valid = strlen(nonce) == 64;
	long value;

	for (size_t i = 0; valid && i < 64; i++) {
		valid = isxdigit((unsigned char)nonce[i]);
	}

	value = strtol(threshold_text, &end, 10);
	if (!valid || !*threshold_text || *end || value < -40000 || value > 125000) {
		reply_append("{\"ok\":false,\"error\":\"invalid_parameters\"}");
	} else if (!strcmp(last_request, nonce)) {
		reply_append("{\"ok\":false,\"error\":\"duplicate_last_request\"}");
	} else {
		/* The host verifies approval before sending APPLY. */
		atomic_set(&threshold, value);
		atomic_inc(&generation);
		strcpy(last_request, nonce);
		reply_append("{\"ok\":true,\"threshold_mdegc\":%ld,\"generation\":%u", value,
			     (unsigned int)atomic_get(&generation));
		reply_run_state();
		reply_append("}");
	}
}

static void handle_command(char *line)
{
	char *save;
	char *tokens[6];
	char *end;
	const char *op;
	unsigned long id_number;
	unsigned int id;
	int count = 0;

	for (char *t = strtok_r(line, " \r\t", &save); t && count < 6;
	     t = strtok_r(NULL, " \r\t", &save)) {
		tokens[count++] = t;
	}
	if (count < 2 || tokens[0][0] != '@') {
		return;
	}

	id_number = strtoul(tokens[0] + 1, &end, 10);
	if (*end || !tokens[0][1] || id_number > UINT32_MAX) {
		return;
	}

	id = id_number;
	op = tokens[1];
	reply_len = 0;
	reply_overflow = false;

	if (!strcmp(op, "HELLO") && count == 2) {
		reply_hello();
	} else if (!strcmp(op, "STATUS") && count == 2) {
		reply_status();
	} else if (!strcmp(op, "UP") && count == 2) {
		reply_presence();
	} else if (!strcmp(op, "START") && count == 3) {
		start_run(tokens[2]);
	} else if (!strcmp(op, "STOP") && count == 2) {
		stop_run();
	} else if (!strcmp(op, "STATS") && count == 2) {
		reply_stats();
	} else if (!strcmp(op, "WORK") && count == 3) {
		configure_work(tokens[2]);
	} else if (!strcmp(op, "SAMPLES") && count == 3) {
		reply_samples(tokens[2]);
	} else if (!strcmp(op, "APPLY") && count == 4) {
		apply_threshold(tokens[2], tokens[3]);
	} else {
		reply_append("{\"ok\":false,\"error\":\"unknown_command_or_arity\"}");
	}
	send_reply(id);
}

int main(void)
{
	char line[192];
	size_t length = 0;
	bool discard = false;
	int ret;

	workload_tid = workload_thread;
	if (!safe_identifier(CONFIG_BENCH_NODE_ID) || !safe_identifier(CONFIG_BENCH_VARIANT)) {
		LOG_ERR("Invalid node identifier or firmware variant");
		return -EINVAL;
	}
	if (!device_is_ready(control_uart)) {
		LOG_ERR("Control UART is not ready");
		return -ENODEV;
	}
#ifdef HAVE_ALARM_LED
	led_ready = gpio_is_ready_dt(&led) && !gpio_pin_configure_dt(&led, GPIO_OUTPUT_INACTIVE);
#endif
#if defined(CONFIG_BENCH_SENSOR)
	if (!device_is_ready(sensor)) {
		sensor_ready_error = -ENODEV;
	}
#endif
#if defined(CONFIG_FIDO2)
	LOG_INF("Initializing FIDO2");
	fido_error = fido2_init();
	if (fido_error) {
		LOG_ERR("FIDO2 initialization failed: %d", fido_error);
	}
#endif
#if defined(CONFIG_USB_DEVICE_STACK_NEXT)
	LOG_INF("Initializing USB");
	usb_error = bench_usb_start(IS_ENABLED(CONFIG_FIDO2) && !fido_error);
	if (usb_error) {
		return usb_error;
	}
#endif

	ret = uart_irq_callback_user_data_set(control_uart, uart_irq, NULL);
	if (ret) {
		LOG_ERR("Control UART callback registration failed: %d", ret);
		return ret;
	}
	uart_irq_rx_enable(control_uart);
#if defined(CONFIG_FIDO2)
	if (!fido_error) {
		fido_error = fido2_start();
		if (fido_error) {
			LOG_ERR("FIDO2 start failed: %d", fido_error);
		}
	}
#endif
	LOG_INF("Control interface ready");

	for (;;) {
		uint8_t byte;

		k_msgq_get(&rx_bytes, &byte, K_FOREVER);
		if (byte == '\n') {
			if (!discard) {
				line[length] = '\0';
				handle_command(line);
			}
			length = 0;
			discard = false;
		} else if (!discard) {
			if (length < sizeof(line) - 1) {
				line[length++] = byte;
			} else {
				discard = true;
				atomic_inc(&rx_overflows);
			}
		}
	}
	return 0;
}
```

## src/bench.h
```c
#ifndef BENCH_H_
#define BENCH_H_

#include <stdbool.h>
#include <stdint.h>

struct bench_up_snapshot {
	uint64_t sequence;
	uint64_t duration_ns;
	uint64_t pre_event_ns;
	uint64_t resume_delay_ns;
	bool event_valid;
	int result;
};

void bench_up_get(struct bench_up_snapshot *snapshot);
int bench_usb_start(bool fido_ready);

#endif /* BENCH_H_ */
```

## src/bench_clock.h
```c
#ifndef BENCH_CLOCK_H_
#define BENCH_CLOCK_H_

#include <zephyr/kernel.h>

static inline uint64_t bench_clock_now(void)
{
#if defined(CONFIG_TIMER_HAS_64BIT_CYCLE_COUNTER)
	return k_cycle_get_64();
#else
	return k_uptime_ticks();
#endif
}

static inline uint32_t bench_clock_hz(void)
{
#if defined(CONFIG_TIMER_HAS_64BIT_CYCLE_COUNTER)
	return sys_clock_hw_cycles_per_sec();
#else
	return CONFIG_SYS_CLOCK_TICKS_PER_SEC;
#endif
}

static inline uint64_t bench_clock_from_ticks(uint64_t ticks)
{
	return ticks * (bench_clock_hz() / CONFIG_SYS_CLOCK_TICKS_PER_SEC);
}

static inline uint64_t bench_hist_bin_units(void)
{
	return DIV_ROUND_UP(bench_clock_hz(), 1000000U);
}

static inline bool bench_clock_valid(void)
{
	uint64_t before = k_uptime_ticks();
	uint64_t units = bench_clock_now();
	uint64_t after = k_uptime_ticks();
	uint32_t hz = bench_clock_hz();
	uint64_t tick;

	if (hz < CONFIG_SYS_CLOCK_TICKS_PER_SEC || hz % CONFIG_SYS_CLOCK_TICKS_PER_SEC) {
		return false;
	}

	/* Absolute release times require the counter and ticks to share an epoch. */
	tick = units / (hz / CONFIG_SYS_CLOCK_TICKS_PER_SEC);
	return tick >= before && tick <= after;
}

#endif /* BENCH_CLOCK_H_ */
```

## src/stats.c
```c
#include "stats.h"

void bench_stats_add(struct bench_stats *stats, uint64_t due, uint64_t start, uint64_t finish,
		     uint64_t deadline, uint64_t bin_units)
{
	uint64_t lateness = start > due ? start - due : 0;
	uint64_t response = finish > due ? finish - due : 0;
	uint64_t execution = finish - start;
	uint64_t bin = lateness / bin_units;
	unsigned int bucket = bin < BENCH_HIST_BINS - 1 ? bin : BENCH_HIST_BINS - 1;

	if (stats->captured_samples < BENCH_SAMPLE_CAPACITY) {
		struct bench_sample *sample = &stats->captured[stats->captured_samples++];

		sample->lateness_units = lateness;
		sample->response_units = response;
		sample->execution_units = execution;
	}
	stats->samples++;
	stats->sum_execution_units += execution;
	stats->sum_lateness_units += lateness;
	stats->histogram[bucket]++;
	if (lateness > stats->max_lateness_units) {
		stats->max_lateness_units = lateness;
	}
	if (response > stats->max_response_units) {
		stats->max_response_units = response;
	}
	if (execution > stats->max_execution_units) {
		stats->max_execution_units = execution;
	}
	if (response > deadline) {
		stats->deadline_misses++;
	}
}

uint64_t bench_skip_count(uint64_t next_due, uint64_t now, uint64_t period)
{
	return period && now > next_due ? (now - next_due) / period : 0;
}
```

## src/stats.h
```c
#ifndef BENCH_STATS_H_
#define BENCH_STATS_H_

#include <stdint.h>

#define BENCH_HIST_BINS       257
#define BENCH_SAMPLE_CAPACITY 1024

struct bench_sample {
	uint64_t lateness_units;
	uint64_t response_units;
	uint64_t execution_units;
};

struct bench_stats {
	uint64_t samples;
	uint64_t deadline_misses;
	uint64_t skipped_releases;
	uint64_t max_lateness_units;
	uint64_t max_response_units;
	uint64_t max_execution_units;
	uint64_t sum_lateness_units;
	uint64_t sensor_errors;
	uint64_t sum_execution_units;
	uint32_t captured_samples;
	struct bench_sample captured[BENCH_SAMPLE_CAPACITY];
	uint32_t histogram[BENCH_HIST_BINS];
};

void bench_stats_add(struct bench_stats *stats, uint64_t due, uint64_t start, uint64_t finish,
		     uint64_t deadline, uint64_t bin_units);

/* Elapsed release periods; the caller caps the count at the run end. */
uint64_t bench_skip_count(uint64_t next_due, uint64_t now, uint64_t period);

#endif /* BENCH_STATS_H_ */
```

## src/up_timing.c
```c
#include <errno.h>

#include <zephyr/authentication/fido2/fido2_up.h>
#include <zephyr/input/input.h>
#include <zephyr/kernel.h>

#include "bench.h"

static K_SEM_DEFINE(up_sem, 0, 1);
static struct k_spinlock snapshot_lock;
static struct bench_up_snapshot last_wait;
static uint64_t event_ns;
static bool event_seen;
static bool cancelled;
static bool armed;

static uint64_t now_ns(void)
{
#if defined(CONFIG_TIMER_HAS_64BIT_CYCLE_COUNTER)
	return k_cyc_to_ns_floor64(k_cycle_get_64());
#else
	return k_ticks_to_ns_floor64(k_uptime_ticks());
#endif
}

static void up_input_cb(struct input_event *event, void *user_data)
{
	k_spinlock_key_t key;

	ARG_UNUSED(user_data);
	if (!event->sync || !event->value) {
		return;
	}

	key = k_spin_lock(&snapshot_lock);
	if (armed && !cancelled && !event_seen) {
		event_ns = now_ns();
		event_seen = true;
		k_sem_give(&up_sem);
	}
	k_spin_unlock(&snapshot_lock, key);
}

INPUT_CALLBACK_DEFINE(DEVICE_DT_GET(DT_CHOSEN(zephyr_fido2_up_input)), up_input_cb, NULL);

int fido2_up_wait(void)
{
	uint64_t begin = now_ns();
	int ret = k_sem_take(&up_sem, K_MSEC(CONFIG_FIDO2_UP_TIMEOUT_MS));
	uint64_t end = now_ns();
	k_spinlock_key_t key = k_spin_lock(&snapshot_lock);

	ret = cancelled ? -ECANCELED : (ret ? -ETIMEDOUT : 0);
	last_wait.sequence++;
	last_wait.duration_ns = end - begin;
	last_wait.event_valid = !ret && event_seen && event_ns <= end;
	last_wait.pre_event_ns = last_wait.event_valid && event_ns > begin ? event_ns - begin : 0;
	last_wait.resume_delay_ns = last_wait.event_valid ? end - MAX(event_ns, begin) : 0;
	last_wait.result = ret;
	armed = false;
	k_spin_unlock(&snapshot_lock, key);
	return ret;
}

void fido2_up_reset(void)
{
	k_spinlock_key_t key = k_spin_lock(&snapshot_lock);

	k_sem_reset(&up_sem);
	cancelled = false;
	event_seen = false;
	armed = true;
	k_spin_unlock(&snapshot_lock, key);
}

void fido2_up_cancel(void)
{
	k_spinlock_key_t key = k_spin_lock(&snapshot_lock);

	cancelled = true;
	armed = false;
	k_sem_give(&up_sem);
	k_spin_unlock(&snapshot_lock, key);
}

void bench_up_get(struct bench_up_snapshot *snapshot)
{
	k_spinlock_key_t key = k_spin_lock(&snapshot_lock);

	*snapshot = last_wait;
	k_spin_unlock(&snapshot_lock, key);
}
```

## src/usb.c
```c
#include <zephyr/device.h>
#include <zephyr/logging/log.h>
#include <zephyr/sys/util.h>
#include <zephyr/usb/usbd.h>

#include "bench.h"

LOG_MODULE_REGISTER(bench_usb, LOG_LEVEL_INF);

BUILD_ASSERT(CONFIG_BENCH_USB_VID != 0 && CONFIG_BENCH_USB_PID != 0,
	     "CONFIG_BENCH_USB_VID and CONFIG_BENCH_USB_PID must be nonzero");
BUILD_ASSERT(!IS_ENABLED(CONFIG_FIDO2) || DT_NUM_INST_STATUS_OKAY(zephyr_hid_device) == 1,
	     "The FIDO2 firmware requires exactly one HID device");

USBD_DEVICE_DEFINE(bench_usb, DEVICE_DT_GET(DT_NODELABEL(zephyr_udc0)), CONFIG_BENCH_USB_VID,
		   CONFIG_BENCH_USB_PID);
USBD_DESC_LANG_DEFINE(bench_lang);
USBD_DESC_MANUFACTURER_DEFINE(bench_mfr, "FIDO2 research bench");
USBD_DESC_PRODUCT_DEFINE(bench_product, "Node maintenance authenticator");
USBD_DESC_CONFIG_DEFINE(bench_fs_desc, "Experiment interfaces");
USBD_DESC_CONFIG_DEFINE(bench_hs_desc, "Experiment interfaces");
USBD_CONFIGURATION_DEFINE(bench_fs, 0, 100, &bench_fs_desc);
USBD_CONFIGURATION_DEFINE(bench_hs, 0, 100, &bench_hs_desc);

static void usb_message(struct usbd_context *const ctx, const struct usbd_msg *const msg)
{
	int ret;

	if (!usbd_can_detect_vbus(ctx)) {
		return;
	}
	if (msg->type == USBD_MSG_VBUS_READY) {
		ret = usbd_enable(ctx);
		if (ret) {
			LOG_ERR("USB enable failed: %d", ret);
		}
	}
	if (msg->type == USBD_MSG_VBUS_REMOVED) {
		ret = usbd_disable(ctx);
		if (ret) {
			LOG_ERR("USB disable failed: %d", ret);
		}
	}
}

static int register_configuration(enum usbd_speed speed, struct usbd_config_node *config,
				  bool fido_ready)
{
	/* An unregistered HID device would prevent CDC from starting too. */
	const char *const blocked[] = {"dfu_dfu", fido_ready ? NULL : "hid_0", NULL};
	int ret;

	ret = usbd_add_configuration(&bench_usb, speed, config);
	if (ret) {
		LOG_ERR("USB configuration registration failed: %d", ret);
		return ret;
	}

	ret = usbd_register_all_classes(&bench_usb, speed, 1, blocked);
	if (ret) {
		LOG_ERR("USB class registration failed: %d", ret);
		return ret;
	}

	/* CDC ACM requires the IAD device class. */
	if (IS_ENABLED(CONFIG_USBD_CDC_ACM_CLASS)) {
		usbd_device_set_code_triple(&bench_usb, speed, USB_BCC_MISCELLANEOUS, 0x02, 0x01);
	}

	return 0;
}

int bench_usb_start(bool fido_ready)
{
	int ret;

	ret = usbd_add_descriptor(&bench_usb, &bench_lang);
	if (ret) {
		LOG_ERR("USB language descriptor failed: %d", ret);
		return ret;
	}

	ret = usbd_add_descriptor(&bench_usb, &bench_mfr);
	if (ret) {
		LOG_ERR("USB manufacturer descriptor failed: %d", ret);
		return ret;
	}

	ret = usbd_add_descriptor(&bench_usb, &bench_product);
	if (ret) {
		LOG_ERR("USB product descriptor failed: %d", ret);
		return ret;
	}

	ret = register_configuration(USBD_SPEED_FS, &bench_fs, fido_ready);
	if (ret) {
		return ret;
	}

	if (USBD_SUPPORTS_HIGH_SPEED && usbd_caps_speed(&bench_usb) == USBD_SPEED_HS) {
		ret = register_configuration(USBD_SPEED_HS, &bench_hs, fido_ready);
		if (ret) {
			return ret;
		}
	}

	ret = usbd_msg_register_cb(&bench_usb, usb_message);
	if (ret) {
		LOG_ERR("USB message callback registration failed: %d", ret);
		return ret;
	}

	ret = usbd_init(&bench_usb);
	if (ret) {
		LOG_ERR("USB initialization failed: %d", ret);
		return ret;
	}

	if (!usbd_can_detect_vbus(&bench_usb)) {
		ret = usbd_enable(&bench_usb);
		if (ret) {
			LOG_ERR("USB enable failed: %d", ret);
		}
		return ret;
	}

	return 0;
}
```
